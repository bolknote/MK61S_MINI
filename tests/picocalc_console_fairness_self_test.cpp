#include "console_route.hpp"
#include "usb_screen.hpp"
#include "terminal_core.hpp"
#include "clock.hpp"
#include <cassert>
#include <cstdio>
#include <vector>
#include <deque>
#include <climits>
// CLOCK_SYNC and scan-code paths are unused; exercise the actual console
// router, UsbScreen::receive, encoder and multiplex parsers below.
namespace picocalc::clock {
bool configured() { return false; }
bool set(const DateTime&) { assert(false);return false; }
DateTime get() { return {}; }
}
namespace picocalc::controls { u8 from_scan(unsigned) { return 0; } }

namespace {
using namespace picocalc;
using namespace picocalc::console;
constexpr int PICO_ERROR_TIMEOUT=-2;
struct InputBackend {
    std::deque<int> usb,uart;
    int read(Channel source) {
        auto& bytes=source==Channel::USB?usb:uart;
        if(bytes.empty()) return -1;
        const int value=bytes.front();bytes.pop_front();return value;
    }
};
struct MainInputFixture {
    InputBackend backend;
    int forced=INT_MAX;
    unsigned reads=0,reports=0;
    struct Terminal {
        bool raw_mode=false,source_usb=false;
        std::vector<u8> bytes;
        bool raw() const {return raw_mode;}
        bool input_active() const {return false;}
        bool pending() const {return false;}
        void input_source(bool usb) {source_usb=usb;}
        int receive(u8 byte) {bytes.push_back(byte);return -1;}
    } terminal;
    struct Screen {
        UsbScreen actual;
        std::vector<u8> bytes;
        int receive(u8 byte,u32 now) {bytes.push_back(byte);return actual.receive(byte,now);}
    } screen;
    struct Services {bool active() const {return false;}} services;
    struct SleepClocks {bool usb_available() const {return true;}} sleep_clocks;
    struct Power {
        void activity(u64) {}
        bool asleep() const {return false;}
    } power;
};
MainInputFixture* main_input=nullptr;
}
// Only the hardware endpoints are modeled. Production Route chooses the
// transport/counters, and production UsbScreen parses every delivered byte.
namespace picocalc::console {
int read(bool exclusive,bool) {
    ++main_input->reads;
    return main_input->forced==INT_MAX?routing.read(main_input->backend,exclusive):main_input->forced;
}
bool input_usb() {return routing.input()==Channel::USB;}
bool accept(int value,bool exclusive) {return routing.accept(value,exclusive);}
}
namespace picocalc::controls {void pulse(u8,u32) {assert(false);}}
namespace picocalc::io_worker {void drain() {assert(false);}}
namespace picocalc::psram {void prepare_reset() {assert(false);}}
namespace picocalc {u32 math_self_test() {assert(false);return 1;}}
namespace {
u32 millis() {return 10;}
u64 time_us_64() {return 10000;}
void report(u32) {++main_input->reports;}
void stdio_flush() {assert(false);}
void reset_usb_boot(u32,u32) {assert(false);}
void input(u8,bool) {assert(false);}
void wake(u64) {assert(false);}
void production_main_input(MainInputFixture& fixture) {
    main_input=&fixture;
    auto& terminal=fixture.terminal;
    auto& remote_screen=fixture.screen;
    auto& services=fixture.services;
    auto& sleep_clocks=fixture.sleep_clocks;
    auto& power=fixture.power;
    u32 math_failures=0;
    // Generated by the host runner from main.cpp, including its actual
    // budget/loop/guards/USB decoder/status/terminal/control dispatch.
#include "picocalc_main_input_loop.inc"
    main_input=nullptr;
}
void select_input(MainInputFixture& fixture,Channel channel,bool raw) {
    routing=Route{};fixture.terminal.raw_mode=raw;
    (channel==Channel::USB?fixture.backend.usb:fixture.backend.uart).push_back('Q');
    assert(routing.read(fixture.backend,false)=='Q' && routing.accept('Q',false));
    assert(routing.input()==channel && routing.output()==channel);
}
bool main_input_regression() {
    unsigned cases=0;
    for(Channel channel:{Channel::USB,Channel::UART})for(bool raw:{false,true}) {
        // First use the real empty Route result (-1), retaining the last
        // successful input channel. Then inject other negative read results
        // at the endpoint adapter to cover the SDK timeout and all-negative
        // guard. Route itself currently normalizes backend negatives to -1.
        for(int forced:{INT_MAX,PICO_ERROR_TIMEOUT,-3}) {
            MainInputFixture fixture;select_input(fixture,channel,raw);fixture.forced=forced;
            const auto usb=routing.received(Channel::USB),uart=routing.received(Channel::UART);
            production_main_input(fixture);
            if(fixture.reads!=1 || !fixture.screen.bytes.empty() || !fixture.terminal.bytes.empty() || fixture.reports) {
                std::fprintf(stderr,"Main input no-data FAIL: channel=%s mode=%s read_result=%d reads=%u screen_bytes=%zu terminal_bytes=%zu reports=%u rx_delta=%u/%u\n",
                    channel==Channel::USB?"USB":"UART",raw?"RAW":"COMMAND",forced==INT_MAX?-1:forced,
                    fixture.reads,fixture.screen.bytes.size(),fixture.terminal.bytes.size(),fixture.reports,
                    routing.received(Channel::USB)-usb,routing.received(Channel::UART)-uart);
                return false;
            }
            assert(routing.received(Channel::USB)==usb && routing.received(Channel::UART)==uart);
            assert(fixture.screen.actual.errors()==0 && routing.input()==channel && routing.output()==channel);
            ++cases;
        }
        for(int byte:{0x00,0x05,0xff}) {
            MainInputFixture fixture;select_input(fixture,channel,raw);
            (channel==Channel::USB?fixture.backend.usb:fixture.backend.uart).push_back(byte);
            const auto usb=routing.received(Channel::USB),uart=routing.received(Channel::UART);
            production_main_input(fixture);
            assert(fixture.reads==2 && fixture.screen.actual.errors()==0);
            assert(routing.received(Channel::USB)==usb+(channel==Channel::USB));
            assert(routing.received(Channel::UART)==uart+(channel==Channel::UART));
            assert(fixture.screen.bytes==(channel==Channel::USB?std::vector<u8>{(u8)byte}:std::vector<u8>{}));
            // USB NUL is a protocol delimiter, so it is consumed by the real
            // decoder. A physical NUL on UART is still a terminal byte.
            const bool terminal_byte=byte!=5 && !(byte==0 && channel==Channel::USB);
            assert(fixture.terminal.bytes==(terminal_byte?std::vector<u8>{(u8)byte}:std::vector<u8>{}));
            assert(fixture.reports==(byte==5?1U:0U));
            if(terminal_byte) assert(fixture.terminal.source_usb==(channel==Channel::USB));
            assert(routing.input()==channel && routing.output()==channel);
            ++cases;
        }
    }
    assert(cases==24);
    std::printf("Main production input: %u RAW/COMMAND USB/UART no-data/timeout/NUL/status/FF cases, no ghost bytes/RX and valid transport semantics PASS\n",cases);
    return true;
}
}

int main() {
    if(!main_input_regression()) return 1;
    using namespace picocalc;
    using namespace console;
    using namespace usb_screen_protocol;
    for(bool flood:{false,true}) {
        struct Backend {
            std::vector<u8> usb;
            unsigned at=0,uart_left=1;
            bool usb_on=false,uart_flood=false;
            int read(Channel source) {
                if(source==Channel::USB) return usb_on?usb[at++%usb.size()]:-1;
                if(uart_flood) return 0x1B;
                if(!uart_left) return -1;
                --uart_left;return 0x1B;
            }
        } backend;
        Route route;
        const int initial=route.read(backend,false);
        assert(initial==0x1B && route.accept(initial,false) && route.output()==Channel::UART);
        UsbScreen screen;PacketEncoder encoder;
        auto feed=[&](MessageType type) {
            assert(encoder.encode(type,0,0,nullptr,0)==Status::OK);
            for(unsigned i=0;i<encoder.size();++i) assert(screen.receive(encoder.data()[i],1)<0);
        };
        feed(MessageType::ACTIVATE);feed(MessageType::ATTACH);
        assert(screen.enabled() && screen.attached());
        const u8 ping[]={0x34,0x12};
        assert(encoder.encode(MessageType::PING,0,0,ping,sizeof(ping))==Status::OK);
        backend.usb.assign(encoder.data(),encoder.data()+encoder.size());
        backend.usb_on=true;backend.uart_left=1;backend.uart_flood=flood;
        unsigned usb_bytes=0,uart_bytes=0,pings=0,first_uart=0,first_usb=0,reads=0;
        MultiplexParser observed;
        while(usb_bytes<4096 || (flood && uart_bytes<4096)) {
            assert(++reads<=8192);
            int byte=route.read(backend,true);assert(byte>=0);
            if(route.input()==Channel::USB) {
                if(!first_usb) first_usb=reads;
                ++usb_bytes;
                const auto parsed=observed.push((u8)byte);
                assert(parsed!=MultiplexPushResult::ERROR && parsed!=MultiplexPushResult::TERMINAL_BYTE);
                if(parsed==MultiplexPushResult::PACKET) {
                    assert(observed.packet().type==MessageType::PING);++pings;
                }
                assert(screen.receive((u8)byte,reads+1)<0);
            } else {
                if(!first_uart) first_uart=reads;
                ++uart_bytes;assert(byte==0x1B && route.accept(byte,true));
            }
            assert(route.output()==Channel::UART);
        }
        assert(first_uart<=2 && first_usb<=2 && screen.errors()==0 && pings>100);
        assert(uart_bytes==(flood?4096:1));
        std::printf("Console fairness: USB=%u UART=%u complete_PING=%u owner_ESC_within=%u reads parser_errors=0 PASS\n",
                    usb_bytes,uart_bytes,pings,first_uart);
    }
}
