// id, existing EN/RU objects, action, legacy cell width, EN, UTF-8 RU.
// Included by both the STM32 menu and the portable presentation model.
MK61_MAIN_ITEM(BOOTLOADER, DFU_mode_punct, RU_DFU_mode_punct, DFU_enable, 15, "DFU mode enable", "DFU прошивка")
MK61_MAIN_ITEM(USB_DISK, USB_DISK_punct, RU_USB_DISK_punct, UsbDiskMode, 8, "USB Disk", "USB-диск")
MK61_MAIN_ITEM(SETTINGS, SETTINGS_punct, RU_SETTINGS_punct, settings_select, 8, "Settings", "Настройки")
MK61_MAIN_ITEM(EXPLORER, EXPLORER_punct, RU_EXPLORER_punct, program_store_explorer_select, 8, "Explorer", "Проводник")
MK61_MAIN_ITEM(DEVELOPMENT, DEVELOPMENT_punct, RU_DEVELOPMENT_punct, development_select, 11, "Development", "Разработка")
MK61_MAIN_ITEM(SYSTEM, SYSTEM_punct, RU_SYSTEM_punct, system_select, 6, "System", "Система")
