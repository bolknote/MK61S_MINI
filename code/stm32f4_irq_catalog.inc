/* F401/F411 external vector slots, checked against the device IRQ enums.
 * Keep reserved entries: hardware indexes the complete table.
 * Include with VECTOR_SLOT(index,name) and VECTOR_RESERVED(index).
 */
VECTOR_SLOT(0, WWDG_IRQHandler)
VECTOR_SLOT(1, PVD_IRQHandler)
VECTOR_SLOT(2, TAMP_STAMP_IRQHandler)
VECTOR_SLOT(3, RTC_WKUP_IRQHandler)
VECTOR_SLOT(4, FLASH_IRQHandler)
VECTOR_SLOT(5, RCC_IRQHandler)
VECTOR_SLOT(6, EXTI0_IRQHandler)
VECTOR_SLOT(7, EXTI1_IRQHandler)
VECTOR_SLOT(8, EXTI2_IRQHandler)
VECTOR_SLOT(9, EXTI3_IRQHandler)
VECTOR_SLOT(10, EXTI4_IRQHandler)
VECTOR_SLOT(11, DMA1_Stream0_IRQHandler)
VECTOR_SLOT(12, DMA1_Stream1_IRQHandler)
VECTOR_SLOT(13, DMA1_Stream2_IRQHandler)
VECTOR_SLOT(14, DMA1_Stream3_IRQHandler)
VECTOR_SLOT(15, DMA1_Stream4_IRQHandler)
VECTOR_SLOT(16, DMA1_Stream5_IRQHandler)
VECTOR_SLOT(17, DMA1_Stream6_IRQHandler)
VECTOR_SLOT(18, ADC_IRQHandler)
VECTOR_RESERVED(19)
VECTOR_RESERVED(20)
VECTOR_RESERVED(21)
VECTOR_RESERVED(22)
VECTOR_SLOT(23, EXTI9_5_IRQHandler)
VECTOR_SLOT(24, TIM1_BRK_TIM9_IRQHandler)
VECTOR_SLOT(25, TIM1_UP_TIM10_IRQHandler)
VECTOR_SLOT(26, TIM1_TRG_COM_TIM11_IRQHandler)
VECTOR_SLOT(27, TIM1_CC_IRQHandler)
VECTOR_SLOT(28, TIM2_IRQHandler)
VECTOR_SLOT(29, TIM3_IRQHandler)
VECTOR_SLOT(30, TIM4_IRQHandler)
VECTOR_SLOT(31, I2C1_EV_IRQHandler)
VECTOR_SLOT(32, I2C1_ER_IRQHandler)
VECTOR_SLOT(33, I2C2_EV_IRQHandler)
VECTOR_SLOT(34, I2C2_ER_IRQHandler)
VECTOR_SLOT(35, SPI1_IRQHandler)
VECTOR_SLOT(36, SPI2_IRQHandler)
VECTOR_SLOT(37, USART1_IRQHandler)
VECTOR_SLOT(38, USART2_IRQHandler)
VECTOR_RESERVED(39)
VECTOR_SLOT(40, EXTI15_10_IRQHandler)
VECTOR_SLOT(41, RTC_Alarm_IRQHandler)
VECTOR_SLOT(42, OTG_FS_WKUP_IRQHandler)
VECTOR_RESERVED(43)
VECTOR_RESERVED(44)
VECTOR_RESERVED(45)
VECTOR_RESERVED(46)
VECTOR_SLOT(47, DMA1_Stream7_IRQHandler)
VECTOR_RESERVED(48)
VECTOR_SLOT(49, SDIO_IRQHandler)
VECTOR_SLOT(50, TIM5_IRQHandler)
VECTOR_SLOT(51, SPI3_IRQHandler)
VECTOR_RESERVED(52)
VECTOR_RESERVED(53)
VECTOR_RESERVED(54)
VECTOR_RESERVED(55)
VECTOR_SLOT(56, DMA2_Stream0_IRQHandler)
VECTOR_SLOT(57, DMA2_Stream1_IRQHandler)
VECTOR_SLOT(58, DMA2_Stream2_IRQHandler)
VECTOR_SLOT(59, DMA2_Stream3_IRQHandler)
VECTOR_SLOT(60, DMA2_Stream4_IRQHandler)
VECTOR_RESERVED(61)
VECTOR_RESERVED(62)
VECTOR_RESERVED(63)
VECTOR_RESERVED(64)
VECTOR_RESERVED(65)
VECTOR_RESERVED(66)
VECTOR_SLOT(67, OTG_FS_IRQHandler)
VECTOR_SLOT(68, DMA2_Stream5_IRQHandler)
VECTOR_SLOT(69, DMA2_Stream6_IRQHandler)
VECTOR_SLOT(70, DMA2_Stream7_IRQHandler)
VECTOR_SLOT(71, USART6_IRQHandler)
VECTOR_SLOT(72, I2C3_EV_IRQHandler)
VECTOR_SLOT(73, I2C3_ER_IRQHandler)
VECTOR_RESERVED(74)
VECTOR_RESERVED(75)
VECTOR_RESERVED(76)
VECTOR_RESERVED(77)
VECTOR_RESERVED(78)
VECTOR_RESERVED(79)
VECTOR_RESERVED(80)
VECTOR_SLOT(81, FPU_IRQHandler)
VECTOR_RESERVED(82)
VECTOR_RESERVED(83)
VECTOR_SLOT(84, SPI4_IRQHandler)
#if defined(STM32F411xE)
VECTOR_SLOT(85, SPI5_IRQHandler)
#endif
