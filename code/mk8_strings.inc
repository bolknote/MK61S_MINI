// Generated by tools/generate_mk8_strings.py; do not edit.
// Source: code/mk8_strings.json.
#define M8_CONFIRM_OK "OK \357\356\344\362\342\345\360\344"
#define M8_BUSY "\307\340\355\377\362\356"
#define M8_C5_VOLUME_FOUND "\315\340\351\344\345\355 \362\356\354 C5"
#define M8_CREATE_ERROR "\316\370\350\341\352\340"
#define M8_CREATED_FOLDER "\317\340\357\352\340 \361\356\347\344\340\355\340"
#define M8_DATE_TIME "\304\340\362\340 \350 \342\360\345\354\377"
#define M8_DEVELOPMENT "\320\340\347\360\340\341\356\362\352\340"
#define M8_DFU_FIRMWARE "DFU \357\360\356\370\350\342\352\340"
#define M8_DFU_MODE_MESSAGE "\317\360\356\370\350\342\352\340 DFU"
#define M8_EMPTY_FILESYSTEM "\324\321 \357\363\361\362\340"
#define M8_EMPTY_FOLDER "\317\340\357\352\340 \357\363\361\362\340"
#define M8_ERROR "\316\370\350\341\352\340"
#define M8_ERROR_FILESYSTEM "\316\370\350\341\352\340 \324\321"
#define M8_ERROR_FONT "\316\370\350\341\352\340 \370\360\350\364\362\340"
#define M8_ERROR_IMAGE "\316\370\350\341\352\340 \352\340\360\362\350\355\352\350"
#define M8_ERROR_EDIT "\316\370\350\341\352\340 \357\360\340\342\352\350"
#define M8_ERROR_MARKDOWN "\316\370\350\341\352\340 Markdown"
#define M8_ERROR_NAME "\316\370\350\341\352\340 \350\354\345\355\350"
#define M8_ERROR_READ "\316\370\350\341\352\340 \367\362\345\355\350\377"
#define M8_ERROR_RUN "\316\370\350\341\352\340 \347\340\357\363\361\352\340"
#define M8_ERROR_SCREEN "\316\370\350\341\352\340 \375\352\360\340\355\340"
#define M8_ERROR_USB "\316\370\350\341\352\340 USB"
#define M8_ERROR_VIEW "\316\370\350\341\352\340 \357\360\356\361\354\356\362\360\340"
#define M8_ERROR_WRITE "\316\370\350\341\352\340 \347\340\357\350\361\350"
#define M8_ERROR_RTC "\316\370\350\341\352\340 RTC"
#define M8_INVALID_DATE "\315\345\342\345\360\355\340\377 \344\340\362\340"
#define M8_INVALID_TIME "\350\353\350 \342\360\345\354\377"
#define M8_NOT_SAVED "\315\345 \361\356\365\360\340\355\345\355\356"
#define M8_SAVED "\361\356\365\360\340\355\345\355\373"
#define M8_SAVED_ONE "\361\356\365\360\340\355\345\355\340"
#define M8_EXPLORER "\317\360\356\342\356\344\355\350\352"
#define M8_FILES_MK61 "\324\340\351\353\373 \314\312-61"
#define M8_FLASH_ERASE "\321\362\345\360\345\362\374 FLASH"
#define M8_FLASH_INFO "\310\355\364\356\360\354\340\366\350\377"
#define M8_FLASH_SUFFIX " \324\313"
#define M8_FOCAL "\324\316\312\300\313"
#define M8_FOCAL_STOP "\324\316\312\300\313 \361\362\356\357"
#define M8_FOCAL_READY_FORMAT "\324\316\312\300\313 \343\356\362\356\342: %d"
#define M8_FOCAL_SAVED "\324\316\312\300\313 \361\356\365\360\340\355\345\355"
#define M8_FOCAL_EMPTY "\324\316\312\300\313 \357\363\361\362"
#define M8_FOCAL_NAME "\310\354\377 \324\316\312\300\313"
#define M8_FOCAL_FORMAT "\324\316\312\300\313%s"
#define M8_FOCAL_ERROR_LINE "\321\322\320\316\312\300?"
#define M8_FOCAL_ERROR_SYNTAX "\321\310\315\322\300\312\321\310\321?"
#define M8_FOCAL_ERROR_VAR "\317\305\320\305\314?"
#define M8_FOCAL_ERROR_FUNC "\324\323\315\312?"
#define M8_FOCAL_ERROR_FOR "\326\310\312\313?"
#define M8_FOCAL_ERROR_FULL "\315\305\322 \314\305\321\322\300"
#define M8_FOCAL_ERROR_RETURN "\302\316\307\302\320\300\322?"
#define M8_FOCAL_ERROR_STACK "\321\322\305\312?"
#define M8_FOCAL_ERROR_MATH "\314\300\322?"
#define M8_FOCAL_ERROR_MK "\314\312?"
#define M8_FOCAL_ERROR_NAME "\310\314\337?"
#define M8_FOCAL_ERROR_SLOT "\321\313\316\322?"
#define M8_FONT_APPLIED "\330\360\350\364\362 \357\360\350\354\345\355\345\355"
#define M8_FONT_FIXED "\330\360\350\364\362 5x8"
#define M8_FONT_FORMAT "\330\360\350\364\362 %s"
#define M8_FONTS "\330\360\350\364\362\373..."
#define M8_FONTS_MENU "\314\345\355\376 \330\360\350\364\362\373"
#define M8_FORMAT_NEEDED "\355\363\346\345\355 \364\356\360\354\340\362"
#define M8_FS_DAMAGED "\324\321 \357\356\342\360\345\346\344\345\355\340"
#define M8_GRAPHICS "\303\360\340\364\350\352\340"
#define M8_HARDWARE "\317\353\340\362\340"
#define M8_HARDWARE_CHIP_FORMAT "\327\310\317:%s%c%c"
#define M8_HARDWARE_CHIP_ID_FORMAT "\327\310\317:ID 0x%03X"
#define M8_HARDWARE_MEMORY_FORMAT "\316\307\323:%u \317\307\323:%u"
#define M8_HARDWARE_MEMORY_RAM_FORMAT "\316\307\323:%u \317\307\323:?"
#define M8_HARDWARE_MEMORY_ROM_FORMAT "\316\307\323:? \317\307\323:%u"
#define M8_HARDWARE_MEMORY_UNKNOWN "\316\307\323:? \317\307\323:?"
#define M8_HARDWARE_POWER_UNKNOWN "\317\350\362\340\355\350\345:--,-- \302"
#define M8_HARDWARE_POWER_FORMAT "\317\350\362\340\355\350\345:%u,%02u \302"
#define M8_HARDWARE_MCU_UNKNOWN "\314\312:--,- C"
#define M8_HARDWARE_MCU_FORMAT "\314\312:%s%lu,%lu C"
#define M8_HARDWARE_BATTERY_FORMAT "\301\340\362\340\360\345\377:%u,%02u \302"
#define M8_HARDWARE_BATTERY_ABSENT "\301\340\362\340\360\345\377:\355\345\362"
#define M8_HARDWARE_BATTERY_UNKNOWN "\301\340\362\340\360\345\377:\355\345\350\347\342."
#define M8_HARDWARE_DISPLAY_FORMAT "\335\352\360\340\355:%s"
#define M8_HARDWARE_GENERATOR_FORMAT "\303\345\355\345\360\340\362\356\360:%s"
#define M8_IDLE_SOUND_OFF "5 \354\350\355 \347\342\363\352 \342\373\352\353"
#define M8_IDLE_SOUND_ON "5 \354\350\355 \347\342\363\352 \342\352\353"
#define M8_INFO_RUNTIME_FORMAT "\302\320:%lu \314\321"
#define M8_INFO_SWITCHES_FORMAT "\321\327:%u \323\303:%u%s"
#define M8_INPUT "\302\302\316\304"
#define M8_INPUT_FORMAT "\302\302\316\304 %s"
#define M8_INVALID_NUMBER "\315\345\342\345\360\355\356\345 \367\350\361\353\356"
#define M8_TRY_AGAIN "\317\356\342\362\356\360\350\362\345"
#define M8_PRESS_ANY_KEY "\313\376\341\340\377 \352\353\340\342\350\370\340"
#define M8_ITEM_DELETE "\323\344\340\353\350\362\374"
#define M8_ITEM_EDIT "\320\345\344\340\352\362\350\360\356\342\340\362\374"
#define M8_ITEM_LOAD "\307\340\343\360\363\347\350\362\374"
#define M8_ITEM_MOVE "\317\345\360\345\354\345\361\362\350\362\374"
#define M8_ITEM_NEW_DIRECTORY "\315\356\342\340\377 \357\340\357\352\340"
#define M8_ITEM_RENAME "\317\345\360\345\350\354\345\355\356\342\340\362\374"
#define M8_ITEM_RUN "\307\340\357\363\361\352"
#define M8_ITEM_VIEW "\317\360\356\361\354\356\362\360"
#define M8_LANGUAGE_RUSSIAN "\337\347\373\352 \360\363\361"
#define M8_LOAD_ABBR "\327\322 "
#define M8_MEMORY_105 "\317\340\354\377\362\374 105\330\303"
#define M8_MEMORY_112 "\317\340\354\377\362\374 112\330\303+\317F"
#define M8_MEMORY_AUTO "\317\340\354\377\362\374 \300\302\322\316"
#define M8_MOVED "\317\345\360\345\354\345\371\345\355\356"
#define M8_PROGRAM "\317\360\356\343\360\340\354\354\340"
#define M8_EDIT "\317\360\340\342\352\340"
#define M8_RUN "\307\340\357\363\361\352"
#define M8_CLEAR_DATA "\321\341\360\356\361 \344\340\355\355\373\365"
#define M8_DATA "\304\340\355\355\373\345"
#define M8_CLEARED "\356\367\350\371\345\355\373"
#define M8_SAVE_QUESTION "\321\356\365\360\340\355\350\362\374?"
#define M8_CONFIRM_SAVE "OK=\344\340 ESC=\355\345\362"
#define M8_NEW_PROGRAM ">\315\316\302\300\337"
#define M8_EMPTY_PROGRAM ">\317\323\321\322\316"
#define M8_NAME_EXISTS "\323\346\345 \345\361\362\374"
#define M8_NEW_FILE "\315\356\342\373\351 \364\340\351\353"
#define M8_NEW_FILE_NAME "\310\354\377 \364\340\351\353\340"
#define M8_NEW_FOLDER_HINT "OK: \355\356\342. \357\340\357\352\340"
#define M8_NEW_NAME "\315\356\342\356\345 \350\354\377"
#define M8_NO_MATCH "\315\345\362 \361\356\342\357\340\344."
#define M8_NO_PROGRAMS "\315\345\362 \357\360\356\343\360\340\354\354"
#define M8_BAD_MARKDOWN "\315\345\342\345\360\355\373\351 Markdown"
#define M8_BAD_WBMP "\315\345\342\345\360\355\373\351 WBMP"
#define M8_NOT_AVAILABLE "\355\345\344\356\361\362\363\357\355\340"
#define M8_OLED_SLEEP_15 "OLED \361\356\355 15\354\350\355"
#define M8_OLED_SLEEP_30 "OLED \361\356\355 30\354\350\355"
#define M8_OLED_SLEEP_5 "OLED \361\356\355 5 \354\350\355"
#define M8_OLED_SLEEP_OFF "OLED \361\356\355 \342\373\352\353"
#define M8_OPEN_MK61 "\316\362\352\360\373\362\374 \314\312-61"
#define M8_PARENT_HINT "ESC: \355\340\342\345\360\365"
#define M8_PROGRAM_SAVED "\317\360\356\343\360\340\354\354\340 \361\356\365\360."
#define M8_RANDOM_MK61 "\312 \321\327 MK61"
#define M8_RANDOM_MK61S "\312 \321\327 MK61s"
#define M8_RESET "\321\341\360\356\361"
#define M8_REMOVE_ALL "\323\344\340\353\350\362\374 \342\361\270?"
#define M8_REMOVE_ONE "\323\344\340\353\350\362\374?"
#define M8_REMOVED "\323\344\340\353\345\355\356"
#define M8_RENAMED "\317\345\360\345\350\354\345\355."
#define M8_RTC_CORRECTION "\317\356\357\360\340\342\352\340 RTC"
#define M8_RTC_RANGE "\304\350\340\357\340\347\356\355 RTC"
#define M8_RUNNING "\347\340\357\363\361\352..."
#define M8_SAVE_ABBR "\317\310\321 "
#define M8_SAVE_MK61 "\321\356\365\360\340\355\350\362\374 \314\312-61"
#define M8_SETTINGS "\315\340\361\362\360\356\351\352\350"
#define M8_SETUP_DATE_FORMAT "\304\340\362\340 %.10s"
#define M8_SETUP_TIME_FORMAT "\302\360\345\354\377 %.8s"
#define M8_SETUP_UI_FONT_FORMAT "\330\360\350\364\362 UI:%s"
#define M8_SETUP_UI_SIZE_FORMAT "\320\340\347\354\345\360 UI:%u"
#define M8_SETUP_FONT_NAME_FORMAT "\330\360\350\364\362:%s"
#define M8_SETUP_ROWS_FORMAT "\321\362\360\356\352\350:%u"
#define M8_SETUP_FONT_SIZE_FORMAT "\330\360\350\364\362:%ux%u"
#define M8_SETUP_GAP_FORMAT "\310\355\362\345\360\342\340\353:%u"
#define M8_SETUP_WIDTH_FORMAT "\330\350\360\350\355\340:%u"
#define M8_SETUP_SAMPLE "\316\341\360\340\347\345\366 123\300\301\302"
#define M8_SETUP_SAMPLE_UI "\300\340 \301\341 Wi 123"
#define M8_SETUP_PROPORTIONAL "\317\360\356\357\356\360\366\350\356\355\340\353\374\355\373\351"
#define M8_SETUP_NOT_SUPPORTED "\315\345 \357\356\344\344\345\360\346\340\355"
#define M8_SETUP_NO_GLYPHS "\315\345\362 \361\350\354\342\356\353\356\342"
#define M8_SETUP_UPPERCASE "\300\301\302\303\304\305\306\307\310\311\312\313\314\315\316"
#define M8_SETUP_LOWERCASE "\340\341\342\343\344\345\346\347\350\351\352\353\354\355\356"
#define M8_SPEED_CLASSIC "\321\352\356\360\356\361\362\374 \355\356\360\354\340"
#define M8_SPEED_MAXIMUM "\321\352\356\360\356\361\362\374 \354\340\352\361"
#define M8_THIS_FOLDER "\335\362\340 \357\340\357\352\340"
#define M8_USB_DETAILS "\357\356\344\360\356\341\355\356: vlog"
#define M8_USB_DISK "USB-\344\350\361\352"
#define M8_USB_EXIT "ESC \342\373\365\356\344"
#define M8_USB_SCREEN "USB-\375\352\360\340\355"
#define M8_USB_WAIT "\346\344\270\354 \357\360\350\353\356\346\345\355\350\345"
#define M8_VOLUME_FORMAT "\303\360\356\354\352\356\361\362\374 %u"
#define M8_VOLUME_10 "\303\360\356\354\352\356\361\362\374 10"
#define M8_TEST_MENU "\314\345\355\376"
#define M8_TEST_FONT_SAMPLE "\300\340 \301\341 Wi 123"
#define M8_TEST_AA_WI "\300\340 Wi"
#define M8_TEST_MIXED_TEXT "A\306i\270 W9\363"
#define M8_TEST_LONG_REPLACEMENT "\316\367\345\355\374 \344\353\350\355\355\340\377 \361\362\360\356\352\340 \344\353\377 \347\340\354\345\355\373"
#define M8_TEST_LOWER_LINE "\315\350\346\355\377\377 \361\362\360\356\352\340"
#define M8_TB_NO_SPACE "\315\305\322 \314\305\321\322\300"
#define M8_TB_WHAT "\327\322\316?"
#define M8_TB_HOW "\312\300\312?"
#define M8_TB_STOP "TinyBASIC \361\362\356\357"
#define M8_TB_NUMBER "\367\350\361\353\356"
#define M8_TB_NAME "\310\354\377"
#define M8_TB_READY "TinyBASIC \343\356\362\356\342"
#define M8_TERMINAL_BELARUS "\241\242 Belarus"
#define M8_TERMINAL_USB_RUSSIAN "USB + \320\363\361\361\352\350\351"
#define M8_TH_VER "\342\345\360\361\350\377 \357\360\356\370\350\342\352\350"
#define M8_TH_IDENTITY "\350\344\345\355\362\350\364\350\352\340\362\356\360\373 \363\361\362\360\356\351\361\362\342\340 \350 \361\341\356\360\352\350"
#define M8_TH_DATE "date [ms|\303\303\303\303-\314\314-\304\304 \327\327:\314\314:\321\321] \227 \367\340\361\373"
#define M8_TH_ALARM "\361\356\361\362\356\377\355\350\345 \350 \355\340\361\362\360\356\351\352\340 \341\363\344\350\353\374\355\350\352\356\342 RTC A/B"
#define M8_TH_HELP "\375\362\340 \361\357\360\340\342\352\340"
#define M8_TH_HISTORY "\357\356\361\353\345\344\355\350\345 \352\356\354\340\355\344\373"
#define M8_TH_LIST "\357\340\354\377\362\374 \357\360\356\343\360\340\354\354: HEX, \361\362\356\353\341\366\356\354"
#define M8_TH_DUMP "\357\340\354\377\362\374 \357\360\356\343\360\340\354\354: HEX, \361\362\360\356\352\340\354\350"
#define M8_TH_PUB "\353\350\361\362\350\355\343 \357\360\356\343\360\340\354\354\373 \344\353\377 \357\363\341\353\350\352\340\366\350\350"
#define M8_TH_LASM "\344\350\347\340\361\361\345\354\341\353\350\360\356\342\340\362\374 \357\360\356\343\360\340\354\354\363"
#define M8_TH_ISA "\361\357\360\340\342\356\367\355\350\352 \354\355\345\354\356\355\350\352 \340\361\361\345\354\341\353\345\360\340"
#define M8_TH_ASM "asm [\340\344\360\345\361] <\354\355\345\354\356\355\350\352\350> \227 \340\361\361\345\354\341\353\350\360\356\342\340\362\374"
#define M8_TH_INS "ins <\370\340\343> <\352\356\344> \227 \342\361\362\340\342\350\362\374 \352\356\354\340\355\344\363"
#define M8_TH_HIN "hin <\340\344\360\345\361> <hex> \227 \347\340\357\350\361\340\362\374 \357\340\354\377\362\374 \357\360\356\343\360\340\354\354"
#define M8_TH_HOUT "\357\340\354\377\362\374 \357\360\356\343\360\340\354\354 \342 \342\350\344\345 \352\356\354\340\355\344 hin"
#define M8_TH_REG "\357\356\352\340\347\340\362\374 \360\345\343\350\361\362\360\373 R0\205RE"
#define M8_TH_STACK "\357\356\352\340\347\340\362\374 \361\362\345\352 X,Y,Z,T,X1"
#define M8_TH_POKE "poke <X|Y|Z|T> <\367\350\361\353\356> \227 \347\340\357\350\361\340\362\374 \361\362\345\352"
#define M8_TH_1302 "\357\356\352\340\347\340\362\374 \360\345\343\350\361\362\360 R \312145\310\3121302"
#define M8_TH_RING "\357\356\352\340\347\340\362\374 \352\356\353\374\366\345\342\363\376 \357\340\354\377\362\374 M"
#define M8_TH_KBD "kbd <\361\352\340\355\352\356\344> \227 \355\340\346\340\362\374 \352\353\340\342\350\370\363"
#define M8_TH_LED "led <0|1>[,\354\361,\205] \227 \361\366\345\355\340\360\350\351 \361\342\345\362\356\344\350\356\344\340"
#define M8_TH_BEEP "beep <\303\366>,<\354\361>[,\205] \227 \347\342\363\352\356\342\356\351 \361\366\345\355\340\360\350\351"
#define M8_TH_IF "if <\360\345\343\350\361\362\360><\363\361\353\356\342\350\345><\367\350\361\353\356> <\352\356\354\340\355\344\340>"
#define M8_TH_PRINT "print \"\362\345\352\361\362 {X}\"|off|on \227 \375\352\360\340\355 M61"
#define M8_TH_WAIT "wait <1..60000> \227 \357\340\363\347\340 \361\366\345\355\340\360\350\377, \354\361"
#define M8_TH_RET "\342\356\347\342\360\340\362 \350\347 \361\366\345\355\340\360\350\377 \350\353\350 \353\356\342\363\370\352\350 M61"
#define M8_TH_REINIT "\356\367\350\361\362\350\362\374 \352\340\353\374\352\363\353\377\362\356\360 \350 \356\341\360\340\341\356\362\367\350\352\350 M61"
#define M8_TH_CMD "cmd <\352\356\344> \227 \355\340\341\360\340\362\374 \352\356\354\340\355\344\363 \352\353\340\342\350\370\340\354\350"
#define M8_TH_RUN "run [\350\354\377] \227 \347\340\357\363\361\362\350\362\374 \357\360\356\343\360\340\354\354\363 \350\353\350 \364\340\351\353"
#define M8_TH_OPEN "open <\350\354\377> \227 \356\362\352\360\373\362\374 \364\340\351\353"
#define M8_TH_SAVE "save <\355\356\354\345\360|\357\363\362\374.m61> \227 \361\356\365\360\340\355\350\362\374 \357\360\356\343\360\340\354\354\363"
#define M8_TH_LOAD "load <\355\356\354\345\360|\357\363\362\374.m61> \227 \347\340\343\360\363\347\350\362\374 \357\360\356\343\360\340\354\354\363"
#define M8_TH_PWD "\362\345\352\363\371\350\351 \352\340\362\340\353\356\343 \365\360\340\355\350\353\350\371\340"
#define M8_TH_CD "cd [\357\363\362\374] \227 \361\354\345\355\350\362\374 \352\340\362\340\353\356\343"
#define M8_TH_LS "ls [\357\363\362\374] \227 \357\356\352\340\347\340\362\374 \352\340\362\340\353\356\343"
#define M8_TH_DIR "\362\356 \346\345, \367\362\356 ls"
#define M8_TH_MKDIR "mkdir [-p] <\357\363\362\374> \227 \361\356\347\344\340\362\374 \352\340\362\340\353\356\343\350"
#define M8_TH_MV "mv <\356\362\352\363\344\340> <\352\363\344\340>"
#define M8_TH_RM "rm [-r] <\357\363\362\374> \227 \363\344\340\353\350\362\374 \364\340\351\353 \350\353\350 \344\345\360\345\342\356"
#define M8_TH_DEL "\362\356 \346\345, \367\362\356 rm"
#define M8_TH_RMDIR "rmdir <\357\363\362\374> \227 \363\344\340\353\350\362\374 \357\363\361\362\356\351 \352\340\362\340\353\356\343"
#define M8_TH_DF "\270\354\352\356\361\362\374 C6 \350 \367\350\361\353\356 \363\347\353\356\342"
#define M8_TH_BENCH "\362\345\361\362 \367\362\345\355\350\377 C6 \341\345\347 \347\340\357\350\361\350"
#define M8_TH_FSGET "fsget <\357\363\362\374> \227 \354\340\370\350\355\355\356\345 \367\362\345\355\350\345 \364\340\351\353\340"
#define M8_TH_FSPUT "fsput begin|data|end|cancel \227 \347\340\343\360\363\347\352\340 \364\340\351\353\340"
#define M8_TH_FORMAT "format C6 \227 \364\356\360\354\340\362\350\360\356\342\340\362\374 (Y/y)"
#define M8_TH_CLR "\356\367\350\361\362\350\362\374 \357\340\354\377\362\374 \357\360\356\343\360\340\354\354 (Y/y)"
#define M8_TH_VLOG "\344\350\340\343\355\356\361\362\350\352\340 \350\354\357\356\360\362\340 USB [clear]"
#define M8_TH_USBDISK "\347\340\357\363\361\362\350\362\374 \360\345\346\350\354 USB-\344\350\361\352\340 \344\356 \341\345\347\356\357\340\361\355\356\343\356 \350\347\342\353\345\367\345\355\350\377"
#define M8_TH_FSCLEAN "\363\344\340\353\350\362\374 \342\361\345 \357\363\361\362\373\345 \347\340\357\350\361\350 \365\360\340\355\350\353\350\371\340"
#define M8_TH_DISA "\342\352\353\376\367\350\362\374 \350\353\350 \342\373\352\353\376\367\350\362\374 \344\350\347\340\361\361\345\354\341\353\345\360"
#define M8_TH_USCREEN "\347\340\357\363\361\362\350\362\374 \360\345\346\350\354 USB-\375\352\360\340\355\340"
#define M8_TH_PROF_DEEP_SAVE "prof [start|stop|reset|core|deep <1..5> [\366\350\352\353\373]|save]"
#define M8_TH_PROF_DEEP "prof [start|stop|reset|core|deep <1..5> [\366\350\352\353\373]]"
#define M8_TH_PROF_CORE_SAVE "prof [start|stop|reset|core [\370\340\343\350]|save [\357\363\362\374.txt]]"
#define M8_TH_PROF_CORE "prof [start|stop|reset|core [\370\340\343\350]]"
#define M8_TH_CRASH_TEST "crash [show|clear|save [\357\363\362\374.txt]|test <\361\341\356\351>]"
#define M8_TH_CRASH "crash [show|clear|save [\357\363\362\374.txt]]"
#define M8_TH_WDOG_TEST "wdog [status|test <starve|hang>]"
#define M8_TH_WDOG "wdog [status]"
#define M8_TH_MPU_TEST "mpu [status|test <guard|null|exec>]"
#define M8_TH_MPU "mpu [status]"
#define M8_TH_DISPLAY "display status|reinit|on|off|test <\360\345\346\350\354>"
#define M8_TH_RST "rst [now] \227 \357\345\360\345\347\340\357\363\361\352; \341\345\347 now \357\360\356\361\350\362 \357\356\344\362\342\345\360\346\344\345\355\350\345"
#define M8_TH_DFU "dfu [status] \227 \342\356\351\362\350 \342 ROM DFU \350\353\350 \357\356\352\340\347\340\362\374 \361\356\361\362\356\377\355\350\345"
#define M8_TH_REG_SET "R<\360>= <\367\350\361\353\356|random|raw 12hex> \227 \347\340\357\350\361\340\362\374 \360\345\343\350\361\362\360"
#define M8_TH_SET_CODE "set$<\340\344\360\345\361> <hex> \227 \347\340\357\350\361\340\362\374 \357\340\354\377\362\374 \357\360\356\343\360\340\354\354"
#define M8_TH_AVAILABLE "\304\356\361\362\363\357\355\373\345 \352\356\354\340\355\344\373:"
#define M8_TH_READ_ERROR "\316\370\350\341\352\340 \367\362\345\355\350\377 \361\357\360\340\342\352\350"
#define M8_TH_INSTALL "\323\361\362\340\355\356\342\350\362\345 \357\356\344\365\356\344\377\371\350\345 /System/HELP0.TXT \350 HELP1.TXT"
