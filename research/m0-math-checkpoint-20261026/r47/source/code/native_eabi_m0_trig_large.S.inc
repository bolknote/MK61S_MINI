/* Owned reduction columns. Internal domains: s<2^53; the second
 * product uses the existing fixed pi/2 words (each16-bit word<=55970). */
.section .m0_trig_large,"ax",%progbits
.p2align 2
.hidden mk61_m0_trig_product
regular_func mk61_m0_trig_product
 push {r4,r5,r6,r7,lr}
 mov r4,r8
 push {r4}
 mov lr,r0
 uxth r7,r2
 mov r8,r7
 lsrs r4,r2,#16
 uxth r5,r3
 lsrs r6,r3,#16
 movs r7,#0
 mov r3,r1
 movs r1,#0
 movs r2,#0
 mov r0,lr
 str r7,[r0,#0]
 strh r7,[r0,#4]
 ldrh r0,[r3,#0]
 muls r0,r6
 adds r1,r0
 ldrh r0,[r3,#2]
 muls r0,r5
 adds r1,r0
 adcs r2,r7
 ldrh r0,[r3,#4]
 muls r0,r4
 adds r1,r0
 adcs r2,r7
 ldrh r0,[r3,#6]
 mov r7,r8
 muls r0,r7
 movs r7,#0
 adds r1,r0
 adcs r2,r7
 mov r0,lr
 strh r1,[r0,#6]
 lsrs r1,r1,#16
 lsls r2,r2,#16
 orrs r1,r2
 movs r2,#0
 ldrh r0,[r3,#2]
 muls r0,r6
 adds r1,r0
 ldrh r0,[r3,#4]
 muls r0,r5
 adds r1,r0
 adcs r2,r7
 ldrh r0,[r3,#6]
 muls r0,r4
 adds r1,r0
 adcs r2,r7
 ldrh r0,[r3,#8]
 mov r7,r8
 muls r0,r7
 movs r7,#0
 adds r1,r0
 adcs r2,r7
 mov r0,lr
 strh r1,[r0,#8]
 lsrs r1,r1,#16
 lsls r2,r2,#16
 orrs r1,r2
 movs r2,#0
 ldrh r0,[r3,#4]
 muls r0,r6
 adds r1,r0
 ldrh r0,[r3,#6]
 muls r0,r5
 adds r1,r0
 adcs r2,r7
 ldrh r0,[r3,#8]
 muls r0,r4
 adds r1,r0
 adcs r2,r7
 ldrh r0,[r3,#10]
 mov r7,r8
 muls r0,r7
 movs r7,#0
 adds r1,r0
 adcs r2,r7
 mov r0,lr
 strh r1,[r0,#10]
 lsrs r1,r1,#16
 lsls r2,r2,#16
 orrs r1,r2
 movs r2,#0
 ldrh r0,[r3,#6]
 muls r0,r6
 adds r1,r0
 ldrh r0,[r3,#8]
 muls r0,r5
 adds r1,r0
 adcs r2,r7
 ldrh r0,[r3,#10]
 muls r0,r4
 adds r1,r0
 adcs r2,r7
 ldrh r0,[r3,#12]
 mov r7,r8
 muls r0,r7
 movs r7,#0
 adds r1,r0
 adcs r2,r7
 mov r0,lr
 strh r1,[r0,#12]
 lsrs r1,r1,#16
 lsls r2,r2,#16
 orrs r1,r2
 movs r2,#0
 ldrh r0,[r3,#8]
 muls r0,r6
 adds r1,r0
 ldrh r0,[r3,#10]
 muls r0,r5
 adds r1,r0
 adcs r2,r7
 ldrh r0,[r3,#12]
 muls r0,r4
 adds r1,r0
 adcs r2,r7
 ldrh r0,[r3,#14]
 mov r7,r8
 muls r0,r7
 movs r7,#0
 adds r1,r0
 adcs r2,r7
 mov r0,lr
 strh r1,[r0,#14]
 lsrs r1,r1,#16
 lsls r2,r2,#16
 orrs r1,r2
 movs r2,#0
 ldrh r0,[r3,#10]
 muls r0,r6
 adds r1,r0
 ldrh r0,[r3,#12]
 muls r0,r5
 adds r1,r0
 adcs r2,r7
 ldrh r0,[r3,#14]
 muls r0,r4
 adds r1,r0
 adcs r2,r7
 ldrh r0,[r3,#16]
 mov r7,r8
 muls r0,r7
 movs r7,#0
 adds r1,r0
 adcs r2,r7
 mov r0,lr
 strh r1,[r0,#16]
 lsrs r1,r1,#16
 lsls r2,r2,#16
 orrs r1,r2
 movs r2,#0
 ldrh r0,[r3,#12]
 muls r0,r6
 adds r1,r0
 ldrh r0,[r3,#14]
 muls r0,r5
 adds r1,r0
 adcs r2,r7
 ldrh r0,[r3,#16]
 muls r0,r4
 adds r1,r0
 adcs r2,r7
 ldrh r0,[r3,#18]
 mov r7,r8
 muls r0,r7
 movs r7,#0
 adds r1,r0
 adcs r2,r7
 mov r0,lr
 strh r1,[r0,#18]
 lsrs r1,r1,#16
 lsls r2,r2,#16
 orrs r1,r2
 movs r2,#0
 ldrh r0,[r3,#14]
 muls r0,r6
 adds r1,r0
 ldrh r0,[r3,#16]
 muls r0,r5
 adds r1,r0
 adcs r2,r7
 ldrh r0,[r3,#18]
 muls r0,r4
 adds r1,r0
 adcs r2,r7
 ldrh r0,[r3,#20]
 mov r7,r8
 muls r0,r7
 movs r7,#0
 adds r1,r0
 adcs r2,r7
 mov r0,lr
 strh r1,[r0,#20]
 lsrs r1,r1,#16
 lsls r2,r2,#16
 orrs r1,r2
 movs r2,#0
 ldrh r0,[r3,#16]
 muls r0,r6
 adds r1,r0
 ldrh r0,[r3,#18]
 muls r0,r5
 adds r1,r0
 adcs r2,r7
 ldrh r0,[r3,#20]
 muls r0,r4
 adds r1,r0
 adcs r2,r7
 ldrh r0,[r3,#22]
 mov r7,r8
 muls r0,r7
 movs r7,#0
 adds r1,r0
 adcs r2,r7
 mov r0,lr
 strh r1,[r0,#22]
 lsrs r1,r1,#16
 lsls r2,r2,#16
 orrs r1,r2
 movs r2,#0
 ldrh r0,[r3,#18]
 muls r0,r6
 adds r1,r0
 ldrh r0,[r3,#20]
 muls r0,r5
 adds r1,r0
 adcs r2,r7
 ldrh r0,[r3,#22]
 muls r0,r4
 adds r1,r0
 adcs r2,r7
 mov r0,lr
 strh r1,[r0,#24]
 lsrs r1,r1,#16
 lsls r2,r2,#16
 orrs r1,r2
 movs r2,#0
 ldrh r0,[r3,#20]
 muls r0,r6
 adds r1,r0
 ldrh r0,[r3,#22]
 muls r0,r5
 adds r1,r0
 mov r0,lr
 strh r1,[r0,#26]
 pop {r4}
 mov r8,r4
 pop {r4,r5,r6,r7,pc}
.size mk61_m0_trig_product,.-mk61_m0_trig_product
.p2align 2
.hidden mk61_m0_trig_pi2_product
regular_func mk61_m0_trig_pi2_product
 push {r4,r5,r6,r7,lr}
 mov r4,r8
 mov r5,r9
 mov r6,r10
 push {r4,r5,r6}
 mov lr,r0
 mov r0,r1
 mov r3,r2
 ldrh r4,[r0,#6]
 ldrh r5,[r0,#8]
 ldrh r6,[r0,#10]
 ldrh r7,[r0,#0]
 mov r8,r7
 ldrh r7,[r0,#2]
 mov r9,r7
 ldrh r7,[r0,#4]
 mov r10,r7
 movs r7,#0
 movs r1,#0
 movs r2,#0
 ldrh r0,[r3,#0]
 muls r0,r6
 adds r1,r0
 ldrh r0,[r3,#2]
 muls r0,r5
 adds r1,r0
 adcs r2,r7
 ldrh r0,[r3,#4]
 muls r0,r4
 adds r1,r0
 adcs r2,r7
 ldrh r0,[r3,#6]
 mov r7,r10
 muls r0,r7
 movs r7,#0
 adds r1,r0
 adcs r2,r7
 ldrh r0,[r3,#8]
 mov r7,r9
 muls r0,r7
 movs r7,#0
 adds r1,r0
 adcs r2,r7
 ldrh r0,[r3,#10]
 mov r7,r8
 muls r0,r7
 movs r7,#0
 adds r1,r0
 adcs r2,r7
 lsrs r1,r1,#16
 lsls r2,r2,#16
 orrs r1,r2
 movs r2,#0
 ldrh r0,[r3,#2]
 muls r0,r6
 adds r1,r0
 ldrh r0,[r3,#4]
 muls r0,r5
 adds r1,r0
 adcs r2,r7
 ldrh r0,[r3,#6]
 muls r0,r4
 adds r1,r0
 adcs r2,r7
 ldrh r0,[r3,#8]
 mov r7,r10
 muls r0,r7
 movs r7,#0
 adds r1,r0
 adcs r2,r7
 ldrh r0,[r3,#10]
 mov r7,r9
 muls r0,r7
 movs r7,#0
 adds r1,r0
 adcs r2,r7
 mov r0,lr
 strh r1,[r0,#0]
 lsrs r1,r1,#16
 lsls r2,r2,#16
 orrs r1,r2
 movs r2,#0
 ldrh r0,[r3,#4]
 muls r0,r6
 adds r1,r0
 ldrh r0,[r3,#6]
 muls r0,r5
 adds r1,r0
 adcs r2,r7
 ldrh r0,[r3,#8]
 muls r0,r4
 adds r1,r0
 adcs r2,r7
 ldrh r0,[r3,#10]
 mov r7,r10
 muls r0,r7
 movs r7,#0
 adds r1,r0
 adcs r2,r7
 mov r0,lr
 strh r1,[r0,#2]
 lsrs r1,r1,#16
 lsls r2,r2,#16
 orrs r1,r2
 movs r2,#0
 ldrh r0,[r3,#6]
 muls r0,r6
 adds r1,r0
 ldrh r0,[r3,#8]
 muls r0,r5
 adds r1,r0
 adcs r2,r7
 ldrh r0,[r3,#10]
 muls r0,r4
 adds r1,r0
 adcs r2,r7
 mov r0,lr
 strh r1,[r0,#4]
 lsrs r1,r1,#16
 lsls r2,r2,#16
 orrs r1,r2
 movs r2,#0
 ldrh r0,[r3,#8]
 muls r0,r6
 adds r1,r0
 ldrh r0,[r3,#10]
 muls r0,r5
 adds r1,r0
 adcs r2,r7
 mov r0,lr
 strh r1,[r0,#6]
 lsrs r1,r1,#16
 lsls r2,r2,#16
 orrs r1,r2
 movs r2,#0
 ldrh r0,[r3,#10]
 muls r0,r6
 adds r1,r0
 mov r0,lr
 strh r1,[r0,#8]
 lsrs r1,r1,#16
 mov r0,lr
 strh r1,[r0,#10]
 pop {r4,r5,r6}
 mov r8,r4
 mov r9,r5
 mov r10,r6
 pop {r4,r5,r6,r7,pc}
.size mk61_m0_trig_pi2_product,.-mk61_m0_trig_pi2_product
